## config/boards/arm/fusion/Kconfig.board
```kconfig
# Copyright (c) 2020 Pete Johanson
# SPDX-License-Identifier: MIT

config BOARD_FUSION
    bool "Fusion"
    depends on SOC_NRF52840_QIAA

config BOARD_ENABLE_DCDC
    bool "Enable DCDC mode"
    select SOC_DCDC_NRF52X
    default y
    depends on BOARD_FUSION
```

## config/boards/arm/fusion/Kconfig.defconfig
```kconfig
# Copyright (c) 2020 Pete Johanson
# SPDX-License-Identifier: MIT

if BOARD_FUSION

config BOARD
    default "Fusion"

config ZMK_KEYBOARD_NAME
    default "Fusion"

if USB

config USB_NRFX
    default y

config USB_DEVICE_STACK
    default y

endif # USB

config BT_CTLR
    default BT

config ZMK_BLE
    default y

config ZMK_USB
    default y

config ZMK_BATTERY_VOLTAGE_DIVIDER
    default y

if ZMK_DISPLAY

config LS0XX
    default y

endif # ZMK_DISPLAY

if LVGL

config LVGL_HOR_RES_MAX
    default 144

config LVGL_VER_RES_MAX
    default 168

config LVGL_VDB_SIZE
    default 50

config LVGL_DPI
    default 148

config LVGL_BITS_PER_PIXEL
    default 1

choice LVGL_COLOR_DEPTH
    default LVGL_COLOR_DEPTH_1
endchoice

endif

source "/home/steven/gitproj/zmk/app/steno/Kconfig"

endif # BOARD_FUSION
```

## config/boards/arm/fusion/fusion_defconfig
```kconfig
# SPDX-License-Identifier: MIT

CONFIG_SOC_SERIES_NRF52X=y
CONFIG_SOC_NRF52840_QIAA=y
CONFIG_BOARD_FUSION=y

# Enable MPU
CONFIG_ARM_MPU=y

# enable GPIO
CONFIG_GPIO=y
CONFIG_LED=y
CONFIG_PWM=y
CONFIG_LED_PWM=y

CONFIG_USE_DT_CODE_PARTITION=y

CONFIG_MPU_ALLOW_FLASH_WRITE=y
CONFIG_NVS=y
CONFIG_SETTINGS_NVS=y
CONFIG_FLASH=y
CONFIG_FLASH_PAGE_LAYOUT=y
CONFIG_FLASH_MAP=y

CONFIG_SPI=y
CONFIG_NRFX_SPIM0=y
CONFIG_SPI_NOR=y

CONFIG_ZMK_KSCAN_COMPOSITE_DRIVER=y
CONFIG_ZMK_COMBO_MAX_COMBOS_PER_KEY=8
CONFIG_ZMK_KSCAN_DEBOUNCE_PRESS_MS=2
CONFIG_ZMK_KSCAN_DEBOUNCE_RELEASE_MS=4

CONFIG_ZMK_DISPLAY=y
CONFIG_ZMK_DISPLAY_STATUS_SCREEN_CUSTOM=y
CONFIG_ZMK_WIDGET_BATTERY_STATUS=y
CONFIG_ZMK_WIDGET_OUTPUT_STATUS=y
CONFIG_ZMK_WIDGET_LAYER_STATUS=y
CONFIG_ZMK_WIDGET_WPM_STATUS=y

# CONFIG_LOG=y
# CONFIG_DEBUG=y
# CONFIG_CONSOLE=y
# CONFIG_USE_SEGGER_RTT=y
# CONFIG_RTT_CONSOLE=y
CONFIG_SENSOR_LOG_LEVEL_DBG=y
CONFIG_ZMK_LOG_LEVEL_INF=y
CONFIG_LVGL_LOG_LEVEL_WRN=y
CONFIG_ZMK_USB_LOGGING=n

CONFIG_ZMK_EMBEDDED_STENO=y
CONFIG_ZMK_BLE_KEYBOARD_REPORT_QUEUE_SIZE=256
CONFIG_ZMK_EMBEDDED_STENO_DISP_INVERT=y
CONFIG_ZMK_EMBEDDED_STENO_FONT_ADASCII_8=y
CONFIG_ZMK_EMBEDDED_STENO_KEY_INTERVAL=3
CONFIG_ZMK_EMBEDDED_STENO_NOUNICODE=y
CONFIG_ZMK_EMBEDDED_STENO_LOG_BACKEND_CONSOLE=n
CONFIG_ZMK_EMBEDDED_STENO_DEBUG_HIST=n

CONFIG_PINNACLE=y
CONFIG_PINNACLE_TRIGGER_OWN_THREAD=y
CONFIG_ZMK_MOUSE=y
CONFIG_ZMK_SLEEP=y
CONFIG_ZMK_IDLE_SLEEP_TIMEOUT=420000
CONFIG_ZMK_LED_WIDGETS=y

CONFIG_BT_PERIPHERAL_PREF_MIN_INT=6
CONFIG_BT_PERIPHERAL_PREF_MAX_INT=12
```

## config/boards/shields/cmini/Kconfig.defconfig
```kconfig
if SHIELD_CMINI_DONGLE

    config ZMK_KEYBOARD_NAME
        default "CMini"
        
    config ZMK_SPLIT_ROLE_CENTRAL
        default y

endif

if SHIELD_CMINI_DONGLE || SHIELD_CMINI_LEFT || SHIELD_CMINI_RIGHT 

    config ZMK_SPLIT
        default y

endif
```

## config/boards/shields/cmini/Kconfig.shield
```kconfig
config SHIELD_CMINI_LEFT
    def_bool $(shields_list_contains,cmini_left)

config SHIELD_CMINI_RIGHT
    def_bool $(shields_list_contains,cmini_right)
    
config SHIELD_CMINI_DONGLE
    def_bool $(shields_list_contains,cmini_dongle)
```

## config/boards/shields/dactyl_manuform_4x6/Kconfig.defconfig
```kconfig
if SHIELD_DACTYL_MANUFORM_4x6_DONGLE

    config ZMK_KEYBOARD_NAME
        default "DM-4x6-nrf52840"

    config ZMK_SPLIT_BLE_ROLE_CENTRAL
        default y

endif

if SHIELD_DACTYL_MANUFORM_4x6_LEFT

    config ZMK_KEYBOARD_NAME
        default "DM-4x6(Left)"

endif

if SHIELD_DACTYL_MANUFORM_4x6_RIGHT

    config ZMK_KEYBOARD_NAME
        default "DM-4x6(Right)"

endif

if SHIELD_DACTYL_MANUFORM_4x6_DONGLE || SHIELD_DACTYL_MANUFORM_4x6_LEFT || SHIELD_DACTYL_MANUFORM_4x6_RIGHT

    config ZMK_SPLIT
        default y

endif
```

## config/boards/shields/dactyl_manuform_4x6/Kconfig.shield
```kconfig
config SHIELD_DACTYL_MANUFORM_4x6_LEFT
    def_bool $(shields_list_contains,dactyl_manuform_4x6_left)

config SHIELD_DACTYL_MANUFORM_4x6_RIGHT
    def_bool $(shields_list_contains,dactyl_manuform_4x6_right)
```

## config/boards/shields/reset_nrf52840_dongle/Kconfig.defconfig
```kconfig
# Copyright (c) 2020 The ZMK Contributors
# SPDX-License-Identifier: MIT

if SHIELD_RESET_NRF52840_DONGLE

config ZMK_KEYBOARD_NAME
	default "RESET DONGLE"

endif
```

## config/boards/shields/reset_nrf52840_dongle/Kconfig.shield
```kconfig
# Copyright (c) 2020 The ZMK Contributors
# SPDX-License-Identifier: MIT

config SHIELD_RESET_NRF52840_DONGLE
	def_bool $(shields_list_contains,reset_nrf52840_dongle)
```

## config/boards/shields/settings_reset_dongle/Kconfig.defconfig
```kconfig
# Copyright (c) 2020 The ZMK Contributors
# SPDX-License-Identifier: MIT

if SHIELD_SETTINGS_RESET_DONGLE

config ZMK_KEYBOARD_NAME
	default "SETTINGS RESET DONGLE"

endif
```

## config/boards/shields/settings_reset_dongle/Kconfig.shield
```kconfig
# Copyright (c) 2020 The ZMK Contributors
# SPDX-License-Identifier: MIT

config SHIELD_SETTINGS_RESET_DONGLE
	def_bool $(shields_list_contains,settings_reset_dongle)
```

## config/boards/shields/tbk-mini/Kconfig.defconfig
```kconfig
if SHIELD_TBK-MINI_DONGLE

    config ZMK_KEYBOARD_NAME
        default "TBK-Mini-nrf52840"

    config ZMK_SPLIT_BLE_ROLE_CENTRAL
        default y

endif

if SHIELD_TBK-MINI_LEFT

    config ZMK_KEYBOARD_NAME
        default "TBK-Mini(Left)"

endif

if SHIELD_TBK-MINI_RIGHT

    config ZMK_KEYBOARD_NAME
        default "TBK-Mini(Right)"

endif

if SHIELD_TBK-MINI_DONGLE || SHIELD_TBK-MINI_LEFT || SHIELD_TBK-MINI_RIGHT

    config ZMK_SPLIT
        default y

endif
```

## config/boards/shields/tbk-mini/Kconfig.shield
```kconfig
config SHIELD_TBK-MINI_LEFT
    def_bool $(shields_list_contains,tbk-mini_left)

config SHIELD_TBK-MINI_RIGHT
    def_bool $(shields_list_contains,tbk-mini_right)

config SHIELD_TBK-MINI_DONGLE
    def_bool $(shields_list_contains,tbk-mini_dongle)
```
