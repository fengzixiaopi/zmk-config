## config/boards/shields/cmini-pt/Kconfig.defconfig
```kconfig
if SHIELD_CMINI_PT_DONGLE

    config ZMK_KEYBOARD_NAME
        default "CMini-Pt"

    config ZMK_SPLIT_ROLE_CENTRAL
        default y

endif

if SHIELD_CMINI_PT_LEFT || SHIELD_CMINI_PT_RIGHT || SHIELD_CMINI_PT_DONGLE

    config ZMK_SPLIT
        default y

endif
```

## config/boards/shields/cmini-pt/Kconfig.shield
```kconfig
config SHIELD_CMINI_PT_DONGLE
    def_bool $(shields_list_contains,cmini-pt_dongle)

config SHIELD_CMINI_PT_LEFT
    def_bool $(shields_list_contains,cmini-pt_left)

config SHIELD_CMINI_PT_RIGHT
    def_bool $(shields_list_contains,cmini-pt_right)
```

## config/boards/slicemk/nordic_nrf52840_dongle_slicemk/Kconfig.nordic_nrf52840_dongle_slicemk
```kconfig
config BOARD_NORDIC_NRF52840_DONGLE_SLICEMK
    select SOC_NRF52840_QIAA
    select ZMK_BOARD_COMPAT
```

## config/boards/slicemk/nordic_nrf52840_dongle_slicemk/board.yml
```yaml
board:
  name: nordic_nrf52840_dongle_slicemk
  vendor: slicemk
  socs:
    - name: nrf52840
```

## config/west.yml
```yaml
manifest:
  remotes:
    - name: zmkfirmware
      url-base: https://github.com/petejohanson
    - name: badjeff
      url-base: https://github.com/badjeff
  projects:
    - name: zmk
      remote: zmkfirmware
      revision: feat/pointers-move-scroll
      import: app/west.yml
    - name: zmk-pmw3610-driver
      remote: badjeff
      revision: d8b2b71f0ef4f5f1461491f4f0d5040fb77c15c7
    - name: zmk-split-peripheral-input-relay
      remote: badjeff
      revision: main
    - name: zmk-input-behavior-listener
      remote: badjeff
      revision: main
    - name: cirque-input-module
      remote: badjeff
      revision: main
  self:
    path: config
```
