#include "dactyl_manuform_4x6.dtsi"

&default_transform {
    col-offset = <2>;
};

/ {
    kscan0: kscan {
        compatible = "zmk,kscan-gpio-matrix";
        label = "KSCAN";
        diode-direction = "row2col";

        row-gpios
        = <&pro_micro 18 (GPIO_ACTIVE_HIGH | GPIO_PULL_DOWN)>
        ;
    col-gpios
        = <&pro_micro 9 GPIO_ACTIVE_HIGH>
        ;
    };
};