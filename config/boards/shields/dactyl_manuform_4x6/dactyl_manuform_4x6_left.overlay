#include "dactyl_manuform_4x6.dtsi" // Notice that the main dtsi files are included in the overlay.

&default_transform {
    col-offset = <1>;
};

/ {
    kscan0: kscan {
        compatible = "zmk,kscan-gpio-matrix";
        label = "KSCAN";
        diode-direction = "row2col";

        row-gpios
        = <&pro_micro 18 (GPIO_ACTIVE_HIGH | GPIO_PULL_DOWN)>
        ;
    col-gpios
        = <&pro_micro 4 GPIO_ACTIVE_HIGH>
        ;
    };
};